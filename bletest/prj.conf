## CMakeLists.txt
```
cmake_minimum_required(VERSION 3.20.0)
find_package(Zephyr REQUIRED HINTS $ENV{ZEPHYR_BASE})

project(cat)

target_sources(app PRIVATE src/main.c
    src/ble/service.c)
```

## prj.conf
```kconfig
CONFIG_LOG=y
CONFIG_LOG_INFO_COLOR_GREEN=y
CONFIG_LOG_BACKEND_SHOW_COLOR=y

# Enable floats in printf calls
CONFIG_CBPRINTF_FP_SUPPORT=y

# Configure Bluetooth
CONFIG_BT=y
#CONFIG_BT_DEBUG_LOG=y
#CONFIG_BT_L2CAP_TX_BUF_COUNT=5
CONFIG_BT_PERIPHERAL=y
CONFIG_BT_DEVICE_NAME="CAT"
CONFIG_BT_MAX_CONN=1
#CONFIG_BT_LL_SOFTDEVICE=y
# Show up as a keyboard because testing
CONFIG_BT_DEVICE_APPEARANCE=961
#CONFIG_HEAP_MEM_POOL_SIZE=2048
#CONFIG_SYSTEM_WORKQUEUE_STACK_SIZE=2048
CONFIG_SETTINGS=n
# Disable TF-M Secure UART, its addr space overlaps
# peripherals we use which causes a Bus Fault if enabled.
# See: https://academy.nordicsemi.com/courses/nrf-connect-sdk-intermediate/lessons/lesson-5-serial-peripheral-interface-spi/topic/exercise-1-10/
CONFIG_TFM_SECURE_UART=n
CONFIG_TFM_LOG_LEVEL_SILENCE=y
```

## src/main.c
```c
#include <zephyr/kernel.h>
#include <zephyr/logging/log.h>

#include <zephyr/bluetooth/bluetooth.h>
#include <zephyr/bluetooth/uuid.h>
#include <zephyr/bluetooth/gatt.h>
#include <zephyr/bluetooth/hci.h>

#include "ble/service.h"

LOG_MODULE_REGISTER(main);

void on_connected(struct bt_conn* conn, uint8_t err);
void on_disconnected(struct bt_conn* conn, uint8_t reason);

struct bt_conn_cb bt_callbacks = {
    .connected = on_connected,
    .disconnected = on_disconnected,
};

static struct bt_conn* current_conn = NULL;

void on_connected(struct bt_conn* conn, uint8_t err) {
    if (err) {
        LOG_ERR("connection error: %d", err);
        return;
    }

    LOG_INF("connected!");
    current_conn = bt_conn_ref(conn);
}

void on_disconnected(struct bt_conn* conn, uint8_t reason) {
    LOG_INF("disconnected (reason: %d)", reason);
    if (current_conn) {
        bt_conn_unref(current_conn);
        current_conn = NULL;
    }
}


int main(void)
{
    printf("henlo, friendo!\n");

    int err;
    err = bluetooth_init(&bt_callbacks);
    if (err) {
        LOG_ERR("bluetooth_init() failed with %d", err);
        while(true) {
            k_msleep(1000);
        }
    }
    LOG_INF("Running...");

    while (true) {
        k_msleep(1000);
    }

    return 0;
}

//eof
```
