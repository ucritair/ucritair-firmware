## sensors/boards/arm/entropic_cat/Kconfig.board
```kconfig
# Copyright (c) 2024 Nordic Semiconductor ASA
# SPDX-License-Identifier: Apache-2.0

config BOARD_ENTROPIC_CAT
	bool "Entropic CAT"
	depends on SOC_NRF5340_CPUAPP_QKAA
```

## sensors/boards/arm/entropic_cat/Kconfig.defconfig
```kconfig
# Copyright (c) 2024 Nordic Semiconductor ASA
# SPDX-License-Identifier: Apache-2.0

if BOARD_ENTROPIC_CAT

config BOARD
	default "entropic_cat"


#Build with TF-M as the Secure Execution Environment
config BUILD_WITH_TFM
	default y
endif
```

## zephyrapp/boards/arm/cat5340/Kconfig
```kconfig
# nRF5340 DK board configuration

# Copyright (c) 2019 - 2021 Nordic Semiconductor ASA
# SPDX-License-Identifier: Apache-2.0

if BOARD_CAT5340_NRF5340_CPUAPP || BOARD_CAT5340_NRF5340_CPUAPP_NS

config DOMAIN_CPUNET_BOARD
	string
	default "cat5340/nrf5340/cpunet"
	help
	  The board which will be used for CPUNET domain when creating a multi
	  image application where one or more images should be located on
	  another board. For example hci_ipc on the nRF5340_cpunet for
	  Bluetooth applications.

endif #  BOARD_CAT5340_NRF5340_CPUAPP || BOARD_CAT5340_NRF5340_CPUAPP_NS

config DOMAIN_CPUAPP_BOARD
	string
	default "cat5340/nrf5340/cpuapp"
	depends on BOARD_CAT5340_NRF5340_CPUNET
	help
	  The board which will be used for CPUAPP domain when creating a multi
	  image application where one or more images should be located on
	  another board.
```

## zephyrapp/boards/arm/cat5340/board.yml
```yaml
board:
  name: cat5340
  full_name: nRF5340 DK
  vendor: nordic
  socs:
  - name: 'nrf5340'
    variants:
    - name: 'ns'
      cpucluster: 'cpuapp'
```
